## meta-isar/conf/machine/imx8mmlpd4-evk.conf
```bitbake
#
# Copyright (c) Siemens AG, 2026
#
# SPDX-License-Identifier: MIT

DISTRO_ARCH ?= "arm64"

KERNEL_NAME ?= "mainline-imx8mmlpd4-evk"

U_BOOT_CONFIG:imx8mmlpd4-evk = "imx8mm_evk_defconfig"
U_BOOT_BIN:imx8mmlpd4-evk = "flash.bin"

IMAGE_FSTYPES ?= "wic"
WKS_FILE ?= "imx8mmlpd4-evk.wks.in"
IMAGER_INSTALL:wic += "u-boot-imx8mmlpd4-evk"
IMAGER_BUILD_DEPS += "u-boot-imx8mmlpd4-evk"

IMAGE_INSTALL += "u-boot-tools libubootenv-tool u-boot-script"

# Keep the board DTB explicit for boot flows that consume DTB_FILES.
DTB_FILES = "freescale/imx8mm-evk.dtb"
```

## meta-isar/recipes-bsp/u-boot/files/imx8mmlpd4-evk.its
```
/dts-v1/;

/ {
	description = "U-Boot FIT image";
	#address-cells = <1>;

	images {
		uboot {
			description = "U-Boot";
			data = /incbin/("u-boot-nodtb.bin");
			type = "firmware";
			arch = "arm64";
			os = "u-boot";
			compression = "none";
			load = <0x40200000>;
			entry = <0x40200000>;
			hash {
				algo = "sha256";
			};
		};

		fdt {
			description = "U-Boot DTB";
			data = /incbin/("dts/dt.dtb");
			type = "flat_dt";
			arch = "arm64";
			compression = "none";
			hash {
				algo = "sha256";
			};
		};

		atf {
			description = "ARM Trusted Firmware";
			data = /incbin/("bl31.bin");
			type = "firmware";
			arch = "arm64";
			os = "arm-trusted-firmware";
			compression = "none";
			load = <0x00960000>;
			entry = <0x00960000>;
			hash {
				algo = "sha256";
			};
		};
	};

	configurations {
		default = "conf";
		conf {
			firmware = "uboot";
			loadables = "atf";
			fdt = "fdt";
		};
	};
};
```
